## sdkconfig.defaults
```kconfig
# ESP32-C6 Configuration
CONFIG_IDF_TARGET="esp32c6"

# OpenThread
CONFIG_OPENTHREAD_ENABLED=y
CONFIG_OPENTHREAD_FTD=y
CONFIG_OPENTHREAD_BORDER_ROUTER=y

# Networking
CONFIG_LWIP_IPV6=y
CONFIG_LWIP_IPV6_AUTOCONFIG=y

# NVS
CONFIG_NVS_ENCRYPTION=n

# Logging
CONFIG_LOG_DEFAULT_LEVEL_INFO=y
CONFIG_LOG_COLORS=y

# FreeRTOS
CONFIG_FREERTOS_HZ=1000
CONFIG_FREERTOS_UNICORE=n

# I2C
CONFIG_I2C_ENABLE_DEBUG_LOG=n

# PWM
CONFIG_LEDC_USE_XTAL_CLK=n
```
